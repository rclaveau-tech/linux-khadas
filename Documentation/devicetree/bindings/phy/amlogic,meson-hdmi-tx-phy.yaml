## Documentation/devicetree/bindings/phy/amlogic,meson-hdmi-tx-phy.yaml
```yaml
# SPDX-License-Identifier: (GPL-2.0 OR BSD-2-Clause)
%YAML 1.2
---
$id: http://devicetree.org/schemas/phy/amlogic,meson-hdmi-tx-phy.yaml#
$schema: http://devicetree.org/meta-schemas/core.yaml#

title: Amlogic HDMI TX PHY

maintainers:
  - Ronald Claveau <linux-kernel-dev@aliel.fr>

properties:
  compatible:
    enum:
      - amlogic,meson-gxbb-hdmi-tx-phy
      - amlogic,meson-gxl-hdmi-tx-phy
      - amlogic,meson-g12a-hdmi-tx-phy

  "#phy-cells":
    const: 0

required:
  - compatible
  - "#phy-cells"

additionalProperties: false

examples:
  - |
    hdmi-phy {
        compatible = "amlogic,meson-gxbb-hdmi-tx-phy";
        #phy-cells = <0>;
    };
```
