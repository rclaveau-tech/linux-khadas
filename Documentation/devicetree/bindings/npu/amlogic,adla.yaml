## Documentation/devicetree/bindings/npu/amlogic,adla.yaml
```yaml
# SPDX-License-Identifier: (GPL-2.0-only OR BSD-2-Clause)
%YAML 1.2
---
$id: http://devicetree.org/schemas/npu/amlogic,adla.yaml#
$schema: http://devicetree.org/meta-schemas/core.yaml#

title: Amlogic ADLA Neural Processing Unit

maintainers:
  - Ronald Claveau <linux-kernel-dev@aliel.fr>

description: >
  Amlogic IP for accelerating inference of neural networks.

properties:
  compatible:
    enum:
      - amlogic,t7-adla

  reg:
    maxItems: 1

  clocks:
    maxItems: 4

  clock-names:
    items:
      - const: adla_core_clk
      - const: adla_clk
      - const: adla_clk_parent0
      - const: adla_clk_parent1

  interrupts:
    maxItems: 1

  vnpu-supply: true

  power-domains:
    maxItems: 5

  sram-supply: true

required:
  - compatible
  - reg
  - clocks
  - clock-names
  - interrupts
  - power-domains
  - vnpu-supply

additionalProperties: false

...
```

## drivers/accel/adla/Kconfig
```kconfig
# SPDX-License-Identifier: GPL-2.0-only

config DRM_ACCEL_ADLA
	tristate "Adla (support for Amlogic NPUs)"
	depends on DRM_ACCEL
	depends on ARCH_MESON || COMPILE_TEST
	select DRM_SCHED
	select DRM_GEM_SHMEM_HELPER
	help
	  Choose this option if you have a Amlogic SoC that contains a
	  compatible Neural Processing Unit (NPU), such as the A311D2. Called by
	  Amlogic as ADLA, it accelerates inference of neural networks.

	  If unsure, say N.

	  To compile this driver as a module, choose M here: the
	  module will be called adla.
```

## drivers/accel/adla_legacy/kmd/Kconfig
```kconfig
# SPDX-License-Identifier: GPL-2.0-only

config DRM_ACCEL_ADLA_LEGACY
	tristate "Adla Legacy (support for Amlogic NPUs)"
	depends on DRM_ACCEL
	depends on ARCH_MESON || COMPILE_TEST
	depends on ARM64
	select DRM_SCHED
	select DRM_GEM_SHMEM_HELPER
	help
	  Choose this option if you have a Amlogic SoC that contains a
	  compatible Neural Processing Unit (NPU), such as the A311D2. Called by
	  Amlogic as ADLA, it accelerates inference of neural networks.

	  If unsure, say N.

	  To compile this driver as a module, choose M here: the
	  module will be called amlogic-adla.
```
